## boards/fishball/br2/package/iqtx/Config.in
```kconfig
config BR2_PACKAGE_IQTX
	bool "iqtx"
	help
	  Board test tool for the PL narrowband IQ transmitter: a test
	  tone, a two-tone signal or an IQ file at an offset from the TX
	  LO (plutosatd has its own driver).
	  Source: iqtx/sw in plutosdr-fw.
```

## boards/fishball/br2/package/plutosat-station/Config.in
```kconfig
config BR2_PACKAGE_PLUTOSAT_STATION
	bool "plutosat-station"
	help
	  The PlutoSAT station: the daemon plutosatd (web UI on
	  https://BOARD/, port 80 redirects), the CLI plutosat and the
	  web front end, started by /etc/init.d/S95plutosatd. Its
	  configuration and TLS certificate are kept on the SD card
	  (/mnt/sd/plutosat) or in the QSPI flash (/mnt/jffs2/plutosat).
	  Transmitting is disabled in the first configuration.

	  Built outside buildroot (cargo, npm) by
	  boards/fishball/br2/build-station.sh into build/station; the
	  top-level make TARGET=fishball runs it first.
	  Source: the station submodule (M0PZH/PlutoSAT-station).
```
