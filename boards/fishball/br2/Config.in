## boards/fishball/br2/Config.in
```kconfig
source "$BR2_EXTERNAL_FISHBALL_PATH/package/dvbs2-tx/Config.in"
source "$BR2_EXTERNAL_FISHBALL_PATH/package/nbiq/Config.in"
source "$BR2_EXTERNAL_FISHBALL_PATH/package/selftest/Config.in"
```

## boards/fishball/br2/package/dvbs2-tx/Config.in
```kconfig
config BR2_PACKAGE_DVBS2_TX
	bool "dvbs2-tx"
	help
	  User-space tools for the PL DVB-S2 transmitter and receiver:
	  dvbs2-tx (TS over UDP or from a file -> BBFRAMEs -> DMA) and
	  dvbs2-rx (DMA -> BBFRAMEs -> TS over UDP or to a file).
	  Source: dvbs2/sw in plutosdr-fw.
```

## boards/fishball/br2/package/nbiq/Config.in
```kconfig
config BR2_PACKAGE_NBIQ
	bool "nbiq"
	help
	  User-space tool for the PL narrowband IQ channels: four
	  programmable NCO + CIC + FIR channels (100 kSPS .. 1 MSPS at
	  12 MSPS) streamed to files, stdout or UDP.
	  Source: nbiq/sw in plutosdr-fw.
```

## boards/fishball/br2/package/selftest/Config.in
```kconfig
config BR2_PACKAGE_SELFTEST
	bool "selftest"
	help
	  Loopback self-test: rx-awgn (the PL noise source on the
	  receive samples), ts-prbs (test transport stream generator /
	  checker) and dvbs2-selftest (DVB-S2 end-to-end loopback with an
	  Es/N0 sweep, AD9363 digital or external RF loopback).
	  Source: awgn/sw in plutosdr-fw.
```

## scripts/fishball.its
```
/*
 * U-Boot FIT image source for fishball-sdr-7020: one device tree, the PL
 * bitstream (loaded by u-boot before the kernel), kernel and ramdisk.
 */

/dts-v1/;

/ {
	description = "fishball-sdr-7020: load fpga before Kernel";
	magic = "ITB fishball-sdr-7020";
	#address-cells = <1>;
	images {

		fdt@1 {
			description = "zynq-fishball-sdr-7020";
			data = /incbin/("../build/zynq-fishball-sdr-7020.dtb");
			type = "flat_dt";
			arch = "arm";
			compression = "none";
		};

		fpga@1 {
			description = "FPGA";
			data = /incbin/("../build/system_top.bit");
			type = "fpga";
			arch = "arm";
			compression = "none";
			load = <0xF000000>;
			hash@1 {
				algo = "md5";
			};
		};

		linux_kernel@1 {
			description = "Linux";
			data = /incbin/("../build/zImage");
			type = "kernel";
			arch = "arm";
			os = "linux";
			compression = "none";
			load = <0x8000>;
			entry = <0x8000>;
			hash@1 {
				algo = "md5";
			};
		};

		ramdisk@1 {
			description = "Ramdisk";
			/* xz initramfs, unpacked by the kernel (u-boot never decompresses ramdisks) */
			data = /incbin/("../build/rootfs.cpio.xz");
			type = "ramdisk";
			arch = "arm";
			os = "linux";
			compression = "none";
			hash@1 {
				algo = "md5";
			};
		};
	};

	configurations {
		default = "config@0";
		config@0 {
			description = "Linux with fpga";
			fdt = "fdt@1";
			kernel = "linux_kernel@1";
			ramdisk = "ramdisk@1";
			fpga = "fpga@1";
		};
	};
};
```
